#include <avr/io.h>
#include <avr/interrupt.h>
#include <avr/sleep.h>
#include <avr/pgmspace.h>

#define F_CPU 10000000UL
#include <util/delay.h>
#include "drivers/gameBadge.h"
#include "game.h"
#include <string.h>

uint8_t tileMap[256];							//Tilemap ram (2 screens of 16x8 tiles)
static volatile uint8_t sleepState = 0;			//0 = normal 1 = asleep
static volatile uint8_t frameFlag;				//ms Frame counter to decide when a frame should be drawn

static volatile uint8_t secFlag = 0;			//This flag is set when a seconds transition occurs
static volatile uint8_t day = 0;				//0 = Sunday... 7 - Saturday
static volatile uint8_t amPM = 0;				//am = 0 pm = 1
static volatile uint8_t hours = 11;				//The hours
static volatile uint8_t minutes = 5;			//The minutes
static volatile uint8_t seconds = 0;			//The seconds

//Your flash game data here--------------------------------------------------------------------------------
const char PROGMEM hero[] = {

24, 24,
	
0x00, 0x00, 0x00, 0x00, 0x00, 0x00, 0xe0, 0xf8, 0xfc, 0xfe, 0xfe, 0xff,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 0x00,
	
0x00, 0x00, 0x00, 0x00, 0x00, 0x00, 0x00, 0xe0, 0xf8, 0x3c, 0x9c, 0xdc,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 0x00, 		


};
const char PROGMEM beastTree[] = {
40, 40,
0x00, 0x80, 0xf8, 0xfc, 0xfc, 0xfc, 0xfc, 0xfe, 0xff, 0xff, 0xff, 0xff,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 0x00, 
0x00, 0x00, 0x00, 0x10, 0xb8, 0x50, 0xa8, 0xa8, 0x54, 0x54, 0xaa, 0xaa,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 0x80, 
};

const char PROGMEM ship[] = {
	
24, 16,
0x04, 0x1e, 0xfe, 0xfe, 0xfe, 0xfe, 0xfe, 0xfc, 0xfc, 0xfc, 0xfc, 0xf8,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 0x01, 
0x00, 0x04, 0x1c, 0xf4, 0xf4, 0xb4, 0xfc, 0x88, 0x88, 0x88, 0x98, 0x90,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 0x00, 
	
0x12, 0x7f, 0xff, 0xff, 0xff, 0xfe, 0xfe, 0xfc, 0xfc, 0xfc, 0xfc, 0xfc,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 0x01, 
0x00, 0x12, 0x72, 0xd6, 0xd6, 0xd4, 0xf4, 0x28, 0x28, 0x28, 0x28, 0x28,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 0x00, 

0x04, 0x0e, 0xfe, 0xfe, 0xfe, 0xfc, 0xfc, 0xfc, 0xf8, 0xf8, 0xf8, 0xf8,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 0x01, 
0x00, 0x04, 0x0c, 0x3c, 0x7c, 0x78, 0x78, 0x78, 0x70, 0x70, 0x70, 0x70,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 0x00, 	
		
};

const char PROGMEM debris[] = {
40,8,
0x80, 0xc0, 0xe0, 0xe0, 0xf0, 0xf8, 0xfc, 0xfc, 0xfe, 0xff, 0xff, 0x7f,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 0x80, 
0x00, 0x00, 0x80, 0x40, 0x20, 0x20, 0x50, 0x08, 0x04, 0x04, 0x8a, 0x41,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 0x80, 
};

const char PROGMEM debrisTop[] = {
16,8,
0x00, 0x00, 0x80, 0xc0, 0xe0, 0xe0, 0xf0, 0xf8, 0xfc, 0xfc, 0xfc, 0xfc, 0xfc, 0xfc, 0xb8, 0x90, 
0x00, 0x00, 0x00, 0x00, 0x80, 0x40, 0x20, 0x20, 0x10, 0x28, 0x04, 0x84, 0x44, 0x44, 0xa8, 0x90, 
};

const char PROGMEM tileData[] = {

0x00, 0x40, 0x40, 0x40, 0x58, 0x7c, 0x7c, 0x7e, 0x7e, 0x7a, 0x76, 0x7c,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 0x00, 

//0x00, 0x00, 0x00, 0x00, 0x00, 0x00, 0x00, 0x00, 0x55, 0xaa, 0x51, 0xaa, 0x55,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 0x3e, 	

};

const uint8_t sineWave[] = {
32,34,35,37,38,40,41,43,
44,46,47,48,50,51,52,53,
55,56,57,58,59,59,60,61,
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20,21,23,24,26,27,29,30,
};

//Your game variables (RAM) here-------------------------------------------------------------------------------
uint8_t point = 0;
uint8_t heroFrame = 0;
uint8_t gamePad;

int16_t x = 0;
int16_t beastTreeX = 78; 
int8_t treeFlip = 1;
int16_t debrisX = 0;
int16_t y = 24;

uint8_t shipFrame = 0;
int8_t shipDir = 1;

int16_t floaty = 100;
uint8_t sinePointer[8] = {0, 0, 0, 0, 0, 0, 0, 0};

uint8_t heroDir = 1;

uint16_t clouds = 0;

uint16_t xx = 0;

int16_t baddie = 128;

uint8_t pos = 64;

void gameSetup() {							//This function is called once per boot/program

	setScrollDirection(horizontal);
	//ledState(1);
	memset(tileMap, 47, 256);

	for (int x = 0 ; x < 4 ; x++) {			//Top clouds
		
		fillTiles(x * 8, 32, 8);
		
	}
	
	for (int x = 0 ; x < 4 ; x++) {			//Mid clouds
		
		fillTiles(32 + (x * 8), 0, 3);
		fillTiles(32 + (x * 8) + 4, 3, 3);		
		
	}	
	
	for (int x = 0 ; x < 2 ; x++) {			//Low clouds
		
		fillTiles(64 + (x * 16) + 2, 6, 2);
		fillTiles(64 + (x * 16) + 7, 8, 2);
		fillTiles(64 + (x * 16) + 11, 10, 2);		
		
	}
	
	for (int x = 0 ; x < 4 ; x++) {			//Mountains
		fillTiles((5*32) + (x * 8), 17, 8);	
		fillTiles((4*32) + (x * 8) + 1, 25, 2);
		fillTiles((4*32) + (x * 8) + 4, 29, 2);	
		fillTiles((3*32) + (x * 8) + 1, 27, 2);				
	}	

	for (int x = 0 ; x < 32 ; x++) {			//Ground BG	
		tileMap[(6*32) + x] = 16;		
	}
	
	for (int x = 0 ; x < 8 ; x++) {				//Ground FG
		tileMap[(7*32) + (x * 4) + 0] = 12;
		tileMap[(7*32) + (x * 4) + 1] = 13;
		tileMap[(7*32) + (x * 4) + 2] = 14;
		tileMap[(7*32) + (x * 4) + 3] = 15;					
	}

}

void systemLoop() {

    while (1) {
		if (sleepState) {
			sleep_cpu();
		}				
		else {
			if (frameFlag == 20) {		//Time to draw a frame? (50 Hz)
				frameFlag = 0;			//Reset ms counter
				ledState(1);			//LED is "on" for the frame
				gameFrame();			//New frame of game logic
				ledState(0);			//connect scope to this line to see frame time
			}	
		}
    }
	
}

void gameFrame() {							//This function is called at 50Hz

	gamePad = screenLoad(point);			//Draw the screen and get the buttons

	drawTiles(tileData, tileMap);
	
	drawSprite(beastTree, beastTreeX, 8, 0, treeFlip);				//Tree Y pos on byte boundry = MOAR SPEED
	
	drawSprite(ship, 20, y, shipFrame, shipDir);
	
	//if (floaty < 128) {
		//drawSprite(hero, floaty, (sineWave[sinePointer[0]++] >> 1), 0, 1);
		//if (sinePointer[0] == 128) {
			//sinePointer[0] = 0;
		//}
	//}
	//
	//if (--floaty < -40) {
		//floaty = 150;
		//sinePointer[0] = 0;
	//}
	
	drawSprite(debris, debrisX, 56, 0, normalSprite);					//Attaching fake parallax sprites on row boundries = faster sprite blit
	drawSprite(debrisTop, debrisX + 8, 48, 0, normalSprite);

	shipFrame = 0;			//Default

	if (gamePad & dB) {
		gotoSleep();
	}

	if (gamePad & dUp && y > 0) {
		y--;
		shipFrame = 2;
	}
	if (gamePad & dDown && y < 48) {
		y++;
		shipFrame = 1;
	}
	
	if (gamePad & dLeft) {
		shipDir = -1;
		x -= 1;
		xx -= 3;
		floaty++;
		if (++beastTreeX == 128) {
			beastTreeX = -40;
		}
		clouds--;;
		debrisX += 4;
		if (debrisX > 127) {
			debrisX = -40;
		}
		
		tone(600, 200);
	}
	if (gamePad & dRight) {
		shipDir = 1;
		x += 1;
		clouds += 2;
		floaty--;
		if (--beastTreeX == -40) {
			beastTreeX = 128;
			if (treeFlip == 1) {
				treeFlip = -1;
			}
			else {
				treeFlip = 1;
			}
		}
		debrisX -= 4;
		
		if (debrisX < -40) {
			debrisX = 127;
		}

		tone(1200, 20);

	}
	
	if (gamePad & dMenu) {
		heroFrame = 4;
	}
	if (gamePad & dA) {
		heroFrame = 5;
	}
	if (gamePad & dB) {
		heroFrame = 6;
	}

	clouds--;

	setRowScroll(clouds >> 1, 0);				//Scroll rows 0 and 1 at a lower speed
	setRowScroll(clouds >> 2, 1);		//you
	setRowScroll(clouds >> 3, 2);		//you

	setRowScroll(x >> 1, 3);
	setRowScroll(x >> 1, 4);
	setRowScroll(x >> 1, 5);
	
	setRowScroll(x, 6);		//Scroll row 8 at a higher speed
	setRowScroll(x << 1, 7);			//Scroll row 8 at a higher speed
	
	ledState(0);
	
}

void gotoSleep() {

	sleepState = 1;
	displayOnOff(0);
	ledState(0);
	//Roll around to the main loop which will put us to sleep

}

void fillTiles(uint8_t location, uint8_t startingTile, uint8_t howMany) {
	
	for (int x = location ; x < location + howMany ; x++) {
		tileMap[x] = startingTile++;
	}
	
}

ISR(TCB0_INT_vect) {				//Timer trips? (This timer is disabled in Power-Down sleep mode)

	frameFlag++;					//Once 16 ms has passed, run frame (60 FPS... ish)
	toneLogic();					//Sound checks
	TCB0_INTFLAGS = 1;				//Clear flag
	
}

ISR(PORTA_PORT_vect) {				//PORTA ISR tied to Menu button for sleep wake-up

	if (sleepState) {				//Button change state with sleep mode enabled? WAKE UP! 
		sleepState = 0;
		displayOnOff(1);
	}
	
	PORTA.INTFLAGS = 0x20;			//Clear interrupt flag

}

ISR(RTC_PIT_vect) {						//ISR called every second

	if (++seconds == 60) {				//time lord stuff
		seconds = 0;
		if (++minutes == 60) {
			minutes = 0;
			++hours;
			if (hours == 12) {
				amPM++;					//amPM & 0x01 -> 0 = AM 1 = PM
			}
			if (hours == 13) {			//Time is so stupid. It's a bunch of rocks spinning around a star.
				hours = 1;
			}
		}
	}

	if (!sleepState) {					//If awake, change flag to indicate the seconds changed (for the display)
		secFlag = 1;
	}

	RTC.PITINTFLAGS = RTC_PI_bm;

}